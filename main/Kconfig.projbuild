## main/Kconfig.projbuild
```kconfig
# SPDX-License-Identifier: Apache-2.0
menu "Surveillance Hound"
config SNIFFER_WIFI_DWELL_MS
    int "Passive dwell per Wi-Fi channel (ms)"
    range 150 250
    default 200
config SNIFFER_BLE_WINDOW_MS
    int "Passive BLE window (ms)"
    range 1000 1500
    default 1200
config SNIFFER_DEMO
    bool "Boot directly into isolated demo mode"
    default n
endmenu
```

## tests/c3_radio/main/Kconfig.projbuild
```kconfig
# SPDX-License-Identifier: Apache-2.0
menu "Hound receive-only test"
config SNIFFER_WIFI_DWELL_MS
 int "Wi-Fi channel dwell"
 default 100
config SNIFFER_BLE_WINDOW_MS
 int "BLE passive window"
 default 6000
endmenu
```

## tests/c3_radio/sdkconfig.defaults
```kconfig
# SPDX-License-Identifier: Apache-2.0
CONFIG_IDF_TARGET="esp32c3"
CONFIG_ESPTOOLPY_FLASHSIZE_4MB=y
CONFIG_ESP_CONSOLE_USB_SERIAL_JTAG=y
CONFIG_BT_ENABLED=y
CONFIG_BT_NIMBLE_ENABLED=y
CONFIG_BT_NIMBLE_ROLE_OBSERVER=y
CONFIG_BT_NIMBLE_ROLE_CENTRAL=n
CONFIG_BT_NIMBLE_ROLE_PERIPHERAL=n
CONFIG_BT_NIMBLE_ROLE_BROADCASTER=n
CONFIG_BT_NIMBLE_MAX_CONNECTIONS=1
CONFIG_BT_NIMBLE_HOST_TASK_STACK_SIZE=4096
CONFIG_ESP_COEX_SW_COEXIST_ENABLE=y
CONFIG_ESP_MAIN_TASK_STACK_SIZE=8192
CONFIG_PARTITION_TABLE_SINGLE_APP_LARGE=y
```
